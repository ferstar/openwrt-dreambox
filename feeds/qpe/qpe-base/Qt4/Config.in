## feeds/qpe/qpe-base/Qt4/Config.in
```kconfig
if PACKAGE_Qt4-gui

choice
	prompt "Qt4 Window System"
	default Qt4_WS_QWS

config Qt4_WS_QWS
	bool "QWS Window System"
	depends on FEATURE_drawing-backend_DirectFB
	help
	  Use Qt4's internal QWS Window System.

config Qt4_WS_X11
	bool "X11 Window System"
	depends on FEATURE_drawing-backend_libX11
	help
	  Use X11

endchoice

endif
```

## feeds/qpe/qpe-base/opie-sl/config/core/apps/config.in
```kconfig
  source core/apps/calibrate/config.in
  source core/apps/embeddedkonsole/config.in
  source core/apps/helpbrowser/config.in
  source core/apps/oapp/config.in
  source core/apps/qcop/config.in
  source core/apps/qss/config.in
  source core/apps/taboapp/config.in
  source core/apps/textedit/config.in
```

## feeds/qpe/qpe-base/opie-sl/config/core/pim/config.in
```kconfig
  source core/pim/addressbook/config.in
  source core/pim/datebook/config.in
  source core/pim/notes/config.in
  source core/pim/osearch/config.in
  source core/pim/today/config.in
  source core/pim/todo/config.in
```

## feeds/qpe/qpe-base/opie-sl/config/examples/config.in
```kconfig
  source examples/applet/config.in
  source examples/inputmethod/config.in
  source examples/main-tab/config.in
  source examples/menuapplet/config.in
  source examples/networksettings/config.in
  source examples/opiebluez/config.in
  source examples/opiecore/config.in
  source examples/opiedb/config.in
  source examples/opiemm/config.in
  source examples/opienet/config.in
  source examples/opieui/config.in
  source examples/python/config.in
  source examples/simple/config.in
  source examples/simple-icon/config.in
  source examples/simple-main/config.in
  source examples/simple-pim/config.in
  source examples/todayplugin/config.in
```

## feeds/qpe/qpe-base/opie-sl/config/noncore/applets/config.in
```kconfig
  source noncore/applets/autorotateapplet/config.in
  source noncore/applets/brightnessapplet/config.in
  source noncore/applets/cardapplet/config.in
  source noncore/applets/keyhelper/config.in
  source noncore/applets/memoryapplet/config.in
  source noncore/applets/networkapplet/config.in
  source noncore/applets/notesapplet/config.in
  source noncore/applets/pcmcia/config.in
  source noncore/applets/pyquicklaunch/config.in
  source noncore/applets/volumeapplet2/config.in
  source noncore/applets/wirelessapplet/config.in
  source noncore/applets/zkbapplet/config.in
```

## feeds/qpe/qpe-base/opie-sl/config/noncore/games/config.in
```kconfig
  source noncore/games/backgammon/config.in
  source noncore/games/bounce/config.in
  source noncore/games/buzzword/config.in
  source noncore/games/fifteen/config.in
  source noncore/games/go/config.in
  source noncore/games/kbill/config.in
  source noncore/games/kcheckers/config.in
  source noncore/games/kpacman/config.in
  source noncore/games/mindbreaker/config.in
  source noncore/games/minesweep/config.in
  source noncore/games/oyatzee/config.in
  source noncore/games/parashoot/config.in
  source noncore/games/qasteroids/config.in
  source noncore/games/sfcave/config.in
  source noncore/games/sfcave-sdl/config.in
  source noncore/games/snake/config.in
  source noncore/games/solitaire/config.in
  source noncore/games/tetrix/config.in
  source noncore/games/tictac/config.in
  source noncore/games/wordgame/config.in
  source noncore/games/zlines/config.in
  source noncore/games/zsame/config.in
```

## feeds/qpe/qpe-base/opie-sl/config/noncore/net/opietooth/config.in
```kconfig
config OPIETOOTH
  bool "Bluetooth support"
  depends (LIBQPE || LIBQPE-X11) && LIBOPIE2CORE

if OPIETOOTH
  source noncore/net/opietooth/applet/config.in
  source noncore/net/opietooth/blue-pin/config.in
  source noncore/net/opietooth/lib/config.in
  source noncore/net/opietooth/manager/config.in

endif
```

## feeds/qpe/qpe-base/opie-sl/config/noncore/settings/config.in
```kconfig
  source noncore/settings/appearance2/config.in
  source noncore/settings/aqpkg/config.in
  source noncore/settings/backup/config.in
  source noncore/settings/doctab/config.in
  source noncore/settings/kbddcontrol/config.in
  source noncore/settings/language/config.in
  source noncore/settings/mediummount/config.in
  source noncore/settings/netsystemtime/config.in
  source noncore/settings/networksettings/config.in
  source noncore/settings/networksettings2/config.in
  source noncore/settings/packagemanager/config.in
  source noncore/settings/sound/config.in
  source noncore/settings/sshkeys/config.in
  source noncore/settings/sysinfo/config.in
```

## feeds/qpe/qpe-base/opie-sl/config/noncore/styles/config.in
```kconfig
menu "Styles"
  source noncore/styles/flat/config.in
  source noncore/styles/fresh/config.in
  source noncore/styles/liquid/config.in
  source noncore/styles/metal/config.in
  source noncore/styles/phase/config.in
  source noncore/styles/theme/config.in
  source noncore/styles/web/config.in
endmenu
```

## feeds/qpe/qpe-base/opie-sl/config/noncore/todayplugins/config.in
```kconfig
  source noncore/todayplugins/fortune/config.in
  source noncore/todayplugins/stockticker/config.in
  source noncore/todayplugins/weather/config.in
```

## feeds/qpe/qpe-base/opie/config/core/applets/config.in
```kconfig
  source core/applets/aboutapplet/config.in
  source core/applets/batteryapplet/config.in
  source core/applets/cardmon/config.in
  source core/applets/clipboardapplet/config.in
  source core/applets/clockapplet/config.in
  source core/applets/homeapplet/config.in
  source core/applets/irdaapplet/config.in
  source core/applets/lockapplet/config.in
  source core/applets/logoutapplet/config.in
  source core/applets/multikeyapplet/config.in
  source core/applets/restartapplet/config.in
  source core/applets/rotateapplet/config.in
  source core/applets/screenshotapplet/config.in
  source core/applets/suspendapplet/config.in
  source core/applets/vmemo/config.in
  source core/applets/volumeapplet/config.in
  source core/applets/vtapplet/config.in
```

## feeds/qpe/qpe-base/opie/config/core/pim/today/plugins/config.in
```kconfig
  source core/pim/today/plugins/addressbook/config.in
  source core/pim/today/plugins/datebook/config.in
  source core/pim/today/plugins/mail/config.in
  source core/pim/today/plugins/todolist/config.in
```

## feeds/qpe/qpe-base/opie/config/core/settings/config.in
```kconfig
  source core/settings/button/config.in
  source core/settings/citytime/config.in
  source core/settings/launcher/config.in
  source core/settings/light-and-power/config.in
  source core/settings/security/config.in
```

## feeds/qpe/qpe-base/opie/config/inputmethods/config.in
```kconfig
  source inputmethods/dvorak/config.in
  source inputmethods/handwriting/config.in
  source inputmethods/jumpx/config.in
  source inputmethods/keyboard/config.in
  source inputmethods/kjumpx/config.in
  source inputmethods/multikey/config.in
  source inputmethods/pickboard/config.in
  source inputmethods/unikeyboard/config.in
```

## feeds/qpe/qpe-base/opie/config/noncore/decorations/config.in
```kconfig
menu "Decorations"
  source noncore/decorations/flat/config.in
  source noncore/decorations/liquid/config.in
  source noncore/decorations/polished/config.in
endmenu
```

## feeds/qpe/qpe-base/opie/config/noncore/graphics/config.in
```kconfig
  source noncore/graphics/drawpad/config.in
  source noncore/graphics/opie-eye/config.in
```

## feeds/qpe/qpe-base/opie/config/noncore/multimedia/config.in
```kconfig
  source noncore/multimedia/camera/config.in
  source noncore/multimedia/camera2/config.in
  source noncore/multimedia/opieplayer2/config.in
  source noncore/multimedia/opierec/config.in
  source noncore/multimedia/powerchord/config.in
  source noncore/multimedia/tonleiter/config.in
```

## feeds/qpe/qpe-base/opie/config/noncore/net/config.in
```kconfig
  source noncore/net/ftplib/config.in
  source noncore/net/mail/config.in
  source noncore/net/opie-smb/config.in
  source noncore/net/opieftp/config.in
  source noncore/net/opieirc/config.in
  source noncore/net/opierdesktop/config.in
  source noncore/net/opiestumbler/config.in
  source noncore/net/opietooth/config.in
  source noncore/net/wellenreiter/config.in
```

## feeds/qpe/qpe-base/opie/config/noncore/securityplugins/config.in
```kconfig
  source noncore/securityplugins/blueping/config.in
  source noncore/securityplugins/dummy/config.in
  source noncore/securityplugins/notice/config.in
  source noncore/securityplugins/pin/config.in
```

## feeds/qpe/qpe-base/opie/config/noncore/tools/config.in
```kconfig
  source noncore/tools/calculator/config.in
  source noncore/tools/clock/config.in
  source noncore/tools/euroconv/config.in
  source noncore/tools/formatter/config.in
  source noncore/tools/opie-sh/config.in
  source noncore/tools/pimconverter/config.in
  source noncore/tools/pyquicklauncher/config.in
  source noncore/tools/remote/config.in
```

## feeds/qpe/qpe-base/qte2/Config.in
```kconfig
#

menu "Qte2 Configuration"
	depends on PACKAGE_qte2

config QTE2_RELEASE
	bool "Release or Debug"
	default y
	help
	  Y/N: (-release/-debug)

config QTE2_SHARED
	bool "Shared or Static library"
	default y
	help
	  Y/N: (-shared/-static)

config QTE2_NO_EXCEPTIONS
	bool "(-no-g++-exceptions) Disable exceptions on platforms using the GNU C++ compiler"
	default n
	help
	Y/N: (-no-g++-exceptions/)

# 4 fonts
menu "Qte2 fonts"

config QTE2_FONTS_songti
	bool "songti"
	default y
	help
	  ./files/fonts/songti*

config QTE2_FONTS_unifont
	bool "unifont"
	default y
	help
	  unifont*

config QTE2_FONTS_helvetica
	bool "helvetica"
	default y
	help
	   helv* or ./files/fonts/helvetica*

config QTE2_FONTS_fixed
	bool "fixed"
	default y
	help
	  fixed* 5x7.bdf

config QTE2_FONTS_micro
	bool "micro"
	default y
	help
	  micro*

config QTE2_FONTS_smallsmooth
	bool "smallsmooth"
	default y
	help
	  smallsmooth*

config QTE2_FONTS_smoothtimes
	bool "smoothtimes"
	default y
	help
	  smoothtimes*

config QTE2_FONTS_smoothmono
	bool "smoothmono"
	default n
	help
	  smoothmono* VeraMo*

config QTE2_FONTS_smoothsans
	bool "smoothsans"
	default n
	help
	  smoothsans* Vera.ttf VeraBd.ttf VeraIt.ttf VeraBI.ttf

config QTE2_FONTS_smoothserif
	bool "smoothserif"
	default n
	help
	  smoothserif* VeraSe*

config QTE2_FONTS_babelfish
	bool "babelfish"
	default n
	help
	  babelfish*

config QTE2_FONTS_utopia
	bool "utopia"
	default n
	help
	  UT*

config QTE2_FONTS_lucidux
	bool "lucidux"
	default n
	help
	  lcdx*

config QTE2_FONTS_cursor
	bool "cursor"
	default n
	help
	  cursor*

config QTE2_FONTS_courier
	bool "courier"
	default n
	help
	  cour* c0*

config QTE2_FONTS_japanese
	bool "japanese"
	default n
	help
	  japanese*

endmenu


endmenu
```
